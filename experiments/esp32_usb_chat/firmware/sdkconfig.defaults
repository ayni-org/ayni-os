## experiments/esp32_usb_chat/firmware/sdkconfig.defaults
```kconfig
CONFIG_IDF_TARGET="esp32s3"
CONFIG_ESPTOOLPY_FLASHMODE_DIO=y
CONFIG_ESPTOOLPY_FLASHFREQ_40M=y
CONFIG_ESPTOOLPY_FLASHSIZE_16MB=y
CONFIG_PARTITION_TABLE_CUSTOM=y
CONFIG_PARTITION_TABLE_CUSTOM_FILENAME="partitions.csv"
CONFIG_SPIRAM=y
CONFIG_SPIRAM_MODE_OCT=y
CONFIG_SPIRAM_SPEED_40M=y
CONFIG_SPIRAM_XIP_FROM_PSRAM=y
CONFIG_SPIRAM_USE_CAPS_ALLOC=y
CONFIG_SPIRAM_IGNORE_NOTFOUND=n
CONFIG_FREERTOS_SMP=n
CONFIG_FREERTOS_HZ=1000
CONFIG_COMPILER_OPTIMIZATION_SIZE=y
CONFIG_ESP_CONSOLE_UART_CUSTOM=y
CONFIG_ESP_CONSOLE_UART_NUM=0
CONFIG_ESP_CONSOLE_UART_TX_GPIO=43
CONFIG_ESP_CONSOLE_UART_RX_GPIO=44
CONFIG_ESP_CONSOLE_UART_BAUDRATE=921600
CONFIG_ESP_MAIN_TASK_STACK_SIZE=8192
CONFIG_SPI_FLASH_ENABLE_COUNTERS=y
```

## experiments/esp32_wifi_chat/firmware/main/Kconfig.projbuild
```kconfig
menu "Ayni independent experiment"
config AYNI_WIFI_CHAT
    bool "Touchscreen, Wi-Fi API and BLE remote profile"
    default n
endmenu
```

## tests/portability/esp32_s3/main/Kconfig.projbuild
```kconfig
menu "Ayni independent normal verification"
config AYNI_INITIALIZE_BLANK
    bool "Initialize an entirely erased Ayni partition"
    default n
    help
        Explicit first-use option. Never formats unknown nonblank media.
        Build/run/flash authorization is handled outside this firmware.
endmenu
```
